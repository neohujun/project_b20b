/******************************************************************************
**
**								Copyright (C) 2015  
**				Smartauto(China) Automotive Information System Co.,Ltd.
**								All rights reserved.
**
**----------------------------------File Info----------------------------------
**
**	Filename:		iic.c
**	Abstract:		iic driver
**	Creat By:		Zeno Liu
**	Creat Time:		2015.03.10
**	Version:		v1.0
**
******************************************************************************/

/* \brief
	include files
*/
#include "Drv_IIC.h"
#include "Timer.h"
#include <MC9S08DZ60.h>
#include <hidef.h>

/* \brief
*/
#define	iicADDR_W			0x8A
#define	iicADDR_R			0x8B

/* \brief
*/

static BOOL bIICStart(void);
static BOOL bIICSend8Bit(BYTE data);
static BOOL blIICWrite (BYTE index, BYTE value);
static BOOL blIICWriteStart(void);
static BOOL blWaitSignalOk(BYTE* pSignal, BYTE SignalBit, BOOL OkSignal, WORD wCounter);


static BYTE IICError;

const BYTE LvdsIn_Para[] = 
{
0xFF, 0x00,  //; Page 0
0x02, 0xC8,
0x03, 0xE8,
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0xFF,0xFE,
};

/* \brief
*/
static BOOL blWaitSignalOk(BYTE* pSignal, BYTE SignalBit, BOOL OkSignal, WORD wCounter)
{
	for(; 0!=wCounter; --wCounter)
	{
		if(((*pSignal>>SignalBit)&0x01) == OkSignal)
		{
			return TRUE;
		}

		__RESET_WATCHDOG();
	}
	
	return FALSE;
}


/* \brief
	IIC start
*/
static BOOL bIICStart(void)
{
	IICC1_IICEN = 0;
	IICC1_IICEN = 1;			//reset iic
 
	IICC1_TXAK = 0;			//����Ӧ���ź�
	
	IICS_ARBL = 1;			//Clear any pending interrupt
	IICS_IICIF = 1;
	IICS_TCF = 1;

	IICS_SRW = 0;
	IICC1_TX = 1;
	IICC1_MST = 0;
	TimerWait(1);
	if(!blWaitSignalOk(&IICS, 5, 0, 20000))
	{
		++IICError;
		IICC1_MST = 0;
		return FALSE;
	}
	IICC1_MST = 1;
	TimerWait(1);
	
	return TRUE;
	
}

/* \brief
	IIC start
*/
static BOOL bIICSend8Bit(BYTE data)
{
//	IIC_temp = data;
	
	IICD = data;
	if(!blWaitSignalOk(&IICS, 1, 1, 20000))
	{
		++IICError;
		IICC1_MST = 0;
		return FALSE;
	}
	IICS_IICIF = 1;
	
	if(!blWaitSignalOk(&IICS, 0, 0, 20000))
	{
		++IICError;
		IICC1_MST = 0;
		return FALSE;
	}
	
	return TRUE;
}

static BOOL blIICWrite (BYTE index, BYTE value)
{

	if(!bIICStart())
	{
		return FALSE;
	}

	if(!bIICSend8Bit(iicADDR_W))
	{
		return FALSE;
	}

	if(!bIICSend8Bit(index))
	{
		return FALSE;
	}

	if(!bIICSend8Bit(value))
	{
		return FALSE;
	}
	
	IICC1_MST = 0;
	TimerWait(1);
	
	return TRUE;
}

/* \brief
	IIC read
*/
/*
static BOOL blIICWrite (BYTE index, BYTE value)
{

	if(!bIICSend8Bit(index))
	{
		return FALSE;
	}

	if(!bIICSend8Bit(value))
	{
		return FALSE;
	}
	TimerWait(1);
	return TRUE;
}

static BOOL blIICWriteStart(void)
{
	if(!bIICStart())
	{
		return FALSE;
	}

	if(!bIICSend8Bit(iicADDR_W))
	{
		return FALSE;
	}
	
	return TRUE;
}
*/

/* \brief
	IIC initialization
*/
void vIICInit(BYTE SelfAddr)
{
	IICA = SelfAddr;
	
	IICC1_IICEN = 0;
	IICF_MULT =  0x00;
	IICF_ICR = 0x0B;			// 0x1E :bps = 16M/(1 * 192) = 83.333 kHz  // 0x0B: 40      400KHz
//	SOPT1_IICPS = 1;			//select PTE4,PTE5
	
//	IICC1_IICIE = 1;
	IICC1_IICEN = 1;

	IICError = 0;
}

void vIICWriteDrvConfig(void)
{
	WORD i = 0;
	WORD j = 0;

//	blIICWriteStart();

  	while(j < 5000)
	{
		if((0xFF == LvdsIn_Para[i]) && (0xFE == LvdsIn_Para[i + 1]))
		{
			break;
		}
		blIICWrite(LvdsIn_Para[i],LvdsIn_Para[i + 1]);
		i += 2;
		j++;
	}
	
//	IICC1_MST = 0;
	
}


